#include <EEPROM.h>
#include <WiFi.h>
#include <WiFiManager.h>          // https://github.com/tzapu/WiFiManager WiFi Configuration Magic#include <PubSubClient.h>
#include <PubSubClient.h>
#include <NTPClient.h>
#include <WiFiUdp.h>
#include <Talkie.h>

#include "Freenove_WS2812_Lib_for_ESP32.h"  // RGB

// Talkie phrases
const uint8_t spTHE[]       PROGMEM = {0x08,0xE8,0x3E,0x55,0x01,0xC3,0x86,0x27,0xAF,0x72,0x0D,0x4D,0x97,0xD5,0xBC,0x64,0x3C,0xF2,0x5C,0x51,0xF1,0x93,0x36,0x8F,0x4F,0x59,0x2A,0x42,0x7A,0x32,0xC3,0x64,0xFF,0x3F};
const uint8_t spTIME[]      PROGMEM = {0x0E,0x28,0xAC,0x2D,0x01,0x5D,0xB6,0x0D,0x33,0xF3,0x54,0xB3,0x60,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0xFF,0x07};
const uint8_t spIS[]        PROGMEM = {0x21,0x18,0x96,0x38,0xB7,0x14,0x8D,0x60,0x3A,0xA6,0xE8,0x51,0xB4,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0xFF,0x7F};
const uint8_t spPAUSE1[]    PROGMEM = {0x00,0x00,0x00,0x00,0xFF,0x0F};
const uint8_t spONE[]       PROGMEM = {0xCC,0x67,0x75,0x42,0x59,0x5D,0x3A,0x4F,0x9D,0x36,0x63,0xB7,0x59,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0xFF,0x0F};
const uint8_t spTWO[]       PROGMEM = {0x0E,0x38,0x6E,0x25,0x00,0xA3,0x0D,0x3A,0xA0,0x37,0xC5,0xA0,0x05,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0xFF,0x0F};
const uint8_t spTHREE[]     PROGMEM = {0x02,0xD8,0x2E,0x9C,0x01,0xDB,0xA6,0x33,0x60,0xFB,0x30,0x01,0xEC,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0xFF,0x0F};
const uint8_t spFOUR[]      PROGMEM = {0x0C,0x18,0xB6,0x9A,0x01,0xC3,0x75,0x09,0x60,0xD8,0x0E,0x09,0x30,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0xFF,0x07};
const uint8_t spFIVE[]      PROGMEM = {0x02,0xE8,0x3E,0x8C,0x01,0xDD,0x65,0x08,0x60,0x98,0x4C,0x06,0x34,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0xFE,0x7F};
const uint8_t spSIX[]       PROGMEM = {0x0E,0xD8,0xAE,0xDD,0x03,0x0E,0x38,0xA6,0xD2,0x01,0xD3,0xB4,0x2C,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0xFC,0x3F};
const uint8_t spSEVEN[]     PROGMEM = {0x02,0xB8,0x3A,0x8C,0x01,0xDF,0xA4,0x73,0x40,0x01,0x47,0xB9,0x2F,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0xF3,0xFF};
const uint8_t spEIGHT[]     PROGMEM = {0xC3,0x6C,0x86,0xB3,0x27,0x6D,0x0F,0xA7,0x48,0x99,0x4E,0x55,0x3C,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0xFE,0x1F};
const uint8_t spNINE[]      PROGMEM = {0xCC,0xA1,0x26,0xBB,0x83,0x93,0x18,0xCF,0x4A,0xAD,0x2E,0x31,0xED,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0xFF,0x07};
const uint8_t spTEN[]       PROGMEM = {0x0E,0xD8,0xB1,0xDD,0x01,0x3D,0xA8,0x24,0x7B,0x04,0x27,0x76,0x77,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0xFF,0x0F};
const uint8_t spELEVEN[]    PROGMEM = {0xC3,0xCD,0x76,0x5C,0xAE,0x14,0x0F,0x37,0x9B,0x71,0xDE,0x92,0x55,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0xFF,0x0F};
const uint8_t spTWELVE[]    PROGMEM = {0x06,0x28,0x46,0xD3,0x01,0x25,0x06,0x13,0x20,0xBA,0x70,0x70,0xB6,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0xFF,0x0F};
const uint8_t spTHIRTEEN[]  PROGMEM = {0x08,0xE8,0x2C,0x15,0x01,0x43,0x07,0x13,0xE0,0x98,0xB4,0xA6,0x35,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0xFF,0x01};
const uint8_t spFOURTEEN[]  PROGMEM = {0x0C,0x58,0xAE,0x5C,0x01,0xD9,0x87,0x07,0x51,0xB7,0x25,0xB3,0x8A,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0xF9,0xFF};
const uint8_t spFIFTEEN[]   PROGMEM = {0x08,0xE8,0x2A,0x0D,0x01,0xDD,0xBA,0x31,0x60,0x6A,0xF7,0xA0,0xAE,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0xFF,0x07};
const uint8_t spSIXTEEN[]   PROGMEM = {0x0A,0x58,0x5A,0x5D,0x00,0x93,0x97,0x0B,0x60,0xA9,0x48,0x05,0x0C,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0xFF,0x1F};
const uint8_t spSEVENTEEN[] PROGMEM = {0x02,0x98,0x3A,0x42,0x00,0x5B,0xA6,0x09,0x60,0xDB,0x52,0x06,0x1C,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0xFD,0x3F};
const uint8_t spEIGHTEEN[]  PROGMEM = {0x2E,0x9C,0xD1,0x4D,0x54,0xEC,0x2C,0xBF,0x1B,0x8A,0x99,0x70,0x7C,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0xF3,0xFF};
const uint8_t spNINETEEN[]  PROGMEM = {0xC2,0xEA,0x8A,0x95,0x2B,0x6A,0x05,0x3F,0x71,0x71,0x5F,0x0D,0x12,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0xFF,0x1F};
const uint8_t spTWENTY[]    PROGMEM = {0x01,0x98,0xD1,0xC2,0x00,0xCD,0xA4,0x32,0x20,0x79,0x13,0x04,0x28,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0xFF,0x0F};
const uint8_t spTHIRTY[]    PROGMEM = {0x08,0x98,0xD6,0x15,0x01,0x43,0xBB,0x0A,0x20,0x1B,0x8B,0xE5,0x16,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0xFF,0x01};
const uint8_t spFOURTY[]    PROGMEM = {0x04,0x18,0xB6,0x4C,0x00,0xC3,0x56,0x30,0xA0,0xE8,0xF4,0xA0,0x98,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0xFF,0x01};
const uint8_t spFIFTY[]     PROGMEM = {0x08,0xE8,0x2E,0x84,0x00,0x23,0x84,0x13,0x60,0x38,0x95,0xA5,0x0F,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0xFF,0x1F};
const uint8_t spGOOD[]      PROGMEM = {0x0A,0x28,0xCD,0x34,0x20,0xD9,0x1A,0x45,0x74,0xE4,0x66,0x24,0xAD,0xBA,0xB1,0x8C,0x9B,0x91,0xA5,0x64,0xE6,0x98,0x21,0x16,0x0B,0x96,0x9B,0x4C,0xE5,0xFF,0x01};
const uint8_t spMORNING[]   PROGMEM = {0xCE,0x08,0x52,0x2A,0x35,0x5D,0x39,0x53,0x29,0x5B,0xB7,0x0A,0x15,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0xFC,0xFF};
//uint8_t spAFTERNOON[] PROGMEM = {0xC7,0xCE,0xCE,0x3A,0xCB,0x58,0x1F,0x3B,0x07,0x9D,0x28,0x71,0xB4,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0xFF,0x03};
//uint8_t spEVENING[]   PROGMEM = {0xCD,0x6D,0x98,0x73,0x47,0x65,0x0D,0x6D,0x10,0xB2,0x5D,0x93,0x35,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0xFF,0x03};
const uint8_t spTONE1[]     PROGMEM = {0x8D,0xF2,0xDE,0xDD,0xDD,0x93,0x74,0xAA,0x53,0x9D,0xEA,0x54,0xA7,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0x15,0x0A};
const uint8_t spTONE2[]     PROGMEM = {0x4D,0xF1,0xDE,0xDD,0xDD,0x93,0x74,0xA5,0x2B,0x5D,0xE9,0x4A,0x57,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0x11,0x5A};

#define LED_RGB 16 
#define LED_BLUE 2
#define PIN_BUTTON 0
#define PIN_PWM 25
#define PIN_PTT 4

#define LED_COLOR_WHITE 255, 255, 255
#define LED_COLOR_RED 255, 0, 0
#define LED_COLOR_OFF 0, 0, 0
#define LED_COLOR_BLUE 0, 0, 255
#define LED_COLOR_MAGENTA 255, 0, 255
#define LED_COLOR_YELLOW 255, 255, 0
#define LED_COLOR_VIOLET 238, 130, 238

#define LED_COLOR_GREEN_1 0, 50, 0
#define LED_COLOR_GREEN_2 0, 128, 0
#define LED_COLOR_GREEN_3 50, 205, 50
#define LED_COLOR_GREEN_4 0, 255, 0

#define LED_COLOR_YELLOW_1 100, 100, 0
#define LED_COLOR_YELLOW_2 128, 128, 0
#define LED_COLOR_YELLOW_3 205, 205, 50
#define LED_COLOR_YELLOW_4 255, 255, 0

#define LED_COLOR_ORANGE 255, 165, 0
#define LED_COLOR_PINK 255, 105, 180
#define LED_COLOR_RED_3 205, 50, 50

// wifi mananger:
#define USE_DYNAMIC_PARAMETERS      false

// states:
#define STATE_ERROR -1

#define STATE_CONFIGURE 100
#define STATE_CONNECT_WIFI 101
#define STATE_INIT_SPEECH 102
#define STATE_MQTT_CONNECT 103
#define STATE_INIT_NTP 104
#define STATE_MQTT_LOOP 105
#define STATE_CHECK_WIFI_STATUS 106
#define STATE_CHECK_MQTT_STATUS 107
#define STATE_UPDATE_NTP 108
#define STATE_CHECK_NTP_STATUS 109
#define STATE_CHECK_BUTTON 110
#define STATE_BLINK 111
#define STATE_CHECK_SAY_TIME 112
#define STATE_CHECK_SAY_BEEP 113


#define STATE_MQTT_STATUS 1000
#define STATE_EEPROM_SAVE 1010
#define STATE_SAY_TIME 1020
#define STATE_SAY_BEEP 1030

WiFiClient wifiClient;

WiFiManager wifiManager;
WiFiManagerParameter custom_mqtt_server("mqtt_server", "MQTT server");
WiFiManagerParameter custom_mqtt_username("mqtt_username", "MQTT username");
WiFiManagerParameter custom_mqtt_password("mqtt_password", "MQTT password");
WiFiManagerParameter custom_mqtt_server_port("mqtt_server_port", "MQTT server port");
WiFiManagerParameter custom_ntp_server("ntp_server", "NTP server");
WiFiManagerParameter custom_ntp_timeoffset("ntp_timeoffset", "NTP time offset");

WiFiUDP ntpUDP;
NTPClient timeClient(ntpUDP);

Talkie voice;
PubSubClient mqttClient(wifiClient);

Freenove_ESP32_WS2812 rgb_driver = Freenove_ESP32_WS2812(1, LED_RGB, 0, TYPE_GRB);

int State;
int newState;
uint16_t previousSecond;

bool flagConfigured;
bool flagWifiConnected;
bool flagMqttConnected;
bool flagNtpInited;
bool flagSpeechInited;
bool flagNewSecond;

struct eeprom_storage {
  char wifi_ssid[32];
  char wifi_password[32];
  char ntp_server[30];
  int16_t ntp_timeoffset;

  char mqtt_server[30];
  char mqtt_username[30];
  char mqtt_password[30];
  uint16_t mqtt_server_port;

  uint8_t sayTime[24][2];  // sayTime[0][0] == HOUR1, sayTime[0][1] == MINUTE1
  uint8_t sayBeep[24][2];  // sayBeep[0][0] == HOUR1, sayBeep[0][1] == MINUTE1
} eeprom;

void setup() {
  pinMode(LED_BLUE, OUTPUT);
  pinMode(25, INPUT);  // PWM
  pinMode(PIN_BUTTON, INPUT_PULLUP);  // switch
  pinMode(PIN_PTT, OUTPUT);
  digitalWrite(PIN_PTT, HIGH);


  ledBlue(false);

  EEPROM.begin(sizeof(eeprom));
  EEPROM.get(0, eeprom);

  rgb_driver.begin();
  rgb_driver.setBrightness(10);

  Serial.begin(115200);
  Serial.println("");
  for (uint8_t t = 4; t > 0; t--) {
    Serial.println("SETUP: Flush");
    Serial.flush();
    delay(500);
  }

  Serial.println("SETUP: Starting");

  newState = 0;  // used when new state should be set next loop

  flagWifiConnected = false;
  flagMqttConnected = false;
  flagNtpInited = false;
  flagSpeechInited = false;
  flagConfigured = true;
  flagNewSecond = false;

  if ((digitalRead(PIN_BUTTON) == 0) || (eeprom.wifi_ssid[0] == 0xff)) {
    // 0 = pressed, force config
    flagConfigured = false;
  }
}

// Each loop is 100mS
void loop() {

  /*
  Serial.println("DEBUG: State = " + String(State));
  Serial.println("DEBUG: flagConfigured = " + String(flagConfigured));
  Serial.println("DEBUG: flagWifiConnected = " + String(flagWifiConnected));
  Serial.println("DEBUG: flagMqttConnected = " + String(flagMqttConnected));
  Serial.println("DEBUG: flagNtpInited = " + String(flagNtpInited));
  Serial.println("DEBUG: flagSpeechInited = " + String(flagSpeechInited));
  */

  switch(State) {
    case STATE_ERROR:  // error handler
      {
        ledBlue(false);
        Serial.println("");
        Serial.println("ERROR: Restarting in 10 seconds");
        for (uint8_t i = 0; i< 10; i++) {
          ledRGB(LED_COLOR_RED);
          delay(500);
          ledRGB(LED_COLOR_OFF);
          delay(500);
        }
        ESP.restart();
      }
      break;

    case STATE_CONFIGURE:
      {
        if (flagConfigured == false) {
          ledRGB(LED_COLOR_WHITE);
          wifiManager.setTitle("Say time");
          custom_mqtt_server.setValue(eeprom.mqtt_server, 30);
          wifiManager.addParameter(&custom_mqtt_server);
          custom_mqtt_username.setValue(eeprom.mqtt_username, 30);
          wifiManager.addParameter(&custom_mqtt_username);
          custom_mqtt_password.setValue(eeprom.mqtt_password, 30);
          wifiManager.addParameter(&custom_mqtt_password);
          custom_mqtt_server_port.setValue(String(eeprom.mqtt_server_port).c_str(), 5);
          wifiManager.addParameter(&custom_mqtt_server_port);
          custom_ntp_server.setValue(eeprom.ntp_server, 30);
          wifiManager.addParameter(&custom_ntp_server);
          custom_ntp_timeoffset.setValue(String(eeprom.ntp_timeoffset).c_str(), 5);
          wifiManager.addParameter(&custom_ntp_timeoffset);

          wifiManager.setDebugOutput(true, WM_DEBUG_NOTIFY );
          Serial.println("CONFIG: starting portal");
        
          WiFi.begin();
          String ap_name = "configure-";
          ap_name += String(WiFi.macAddress());
          ap_name.replace(":", "");

          wifiManager.setSaveConfigCallback(saveConfigCallback);

          if (!wifiManager.startConfigPortal(ap_name.c_str())) {
            Serial.println("SETUP: failed");
            setState(STATE_ERROR);
          }
          ledRGB(LED_COLOR_OFF);
          delay(250);
          ledRGB(LED_COLOR_GREEN_4);
          delay(500);
          flagConfigured = true;
          flagWifiConnected = true;
        }
      }
      break;

    case STATE_CONNECT_WIFI:  // connecto to wifi
      {
        if (flagWifiConnected == false) {
          Serial.println("Wifi: SSID '" + String(eeprom.wifi_ssid) + "'");
          Serial.println("Wifi: Pwd '" + String(eeprom.wifi_password) + "'");
          Serial.println("Wifi: Connecting");

          WiFi.begin(eeprom.wifi_ssid, eeprom.wifi_password);
          while (WiFi.status() != WL_CONNECTED) {
            ledRGB(LED_COLOR_GREEN_1);
            delay(250);
            ledRGB(LED_COLOR_GREEN_2);
            delay(250);
          }
          ledRGB(LED_COLOR_GREEN_4);
          delay(500);
          Serial.print("Wifi: Connected, IP: ");
          Serial.println(WiFi.localIP());
          ledRGB(LED_COLOR_OFF);
          flagWifiConnected = true;
        }
      }
      break;

    case STATE_INIT_SPEECH:
      if (flagSpeechInited == false) {
        flagSpeechInited = true;
      }
      break;

    case STATE_MQTT_CONNECT:
      {
        if (flagMqttConnected == false) {
          ledRGB(LED_COLOR_YELLOW_1);
          Serial.println("MQTT: '" + String(eeprom.mqtt_server) + "'");
          mqttClient.setServer(eeprom.mqtt_server, eeprom.mqtt_server_port);
          mqttClient.setCallback(mqttCallback);
          String client_id = "topas-";
          client_id += String(WiFi.macAddress());
          client_id.replace(":", "");
          while (!mqttClient.connected()) {
            ledRGB(LED_COLOR_YELLOW_2);
            if (mqttClient.connect(client_id.c_str(), eeprom.mqtt_username, eeprom.mqtt_password)) {
              break;
            } else {
              Serial.println("MQTT: " + String(mqttClient.state()));
              setState(STATE_ERROR);
              break;
            }
            Serial.print(".");
            ledRGB(LED_COLOR_YELLOW_3);
            delay(150);
         }
          delay(250);
          ledRGB(LED_COLOR_YELLOW_4);
          delay(500);

          Serial.println("MQTT: Connected");
          String topic = getTopic("online");
          mqttClient.publish(topic.c_str(), "1");
          // Serial.println("MQTT: Subscribe " + getTopic("command"));
          mqttClient.subscribe(getTopic("command").c_str());
          mqttClient.subscribe(getTopic("command/#").c_str());
          //mqttClient.subscribe(getTopic("command/setTimeOffset").c_str());
          ledRGB(LED_COLOR_OFF);
          flagMqttConnected = true;
        }
      }
      break;

    case STATE_INIT_NTP:
      {
        if (flagNtpInited == false) {
          Serial.println("NTP: init");
          timeClient.begin();
          timeClient.setPoolServerName(eeprom.ntp_server);
          timeClient.setTimeOffset(eeprom.ntp_timeoffset);
        }
      }
      break;

    // ---------------------------------
    // From State 100 is main loop
    // ---------------------------------
    case STATE_MQTT_LOOP:  // read mqtt loop
      mqttClient.loop();   
      break;

    case STATE_CHECK_WIFI_STATUS:  // make sure wifi is connected
      {
        if (flagWifiConnected && WiFi.status() != WL_CONNECTED) {
          Serial.println("Wifi: lost connection");
          setState(STATE_ERROR);
          delay(250);
        }
      }
      break;

    case STATE_CHECK_MQTT_STATUS:
      {
        if (flagMqttConnected && !mqttClient.connected()) {
          flagMqttConnected = false;
          Serial.println("MQTT: lost connection");
          ledRGB(LED_COLOR_YELLOW_3);
          delay(250);
          ledRGB(LED_COLOR_OFF);
        }
      }
      break;

    case STATE_UPDATE_NTP:
      if (timeClient.update()) {
        ledBlue(true);
        delay(150);
        ledBlue(false);
      }
      break;  

    case STATE_CHECK_NTP_STATUS:
      {
        if (timeClient.isTimeSet()) {
          if (!flagNtpInited) {
            setState(STATE_MQTT_STATUS);  // when time change to valid, send to mqtt
            flagNtpInited = true;
          }
        } else {
          timeClient.getSeconds();  // bug with library
        }
      }
      break;

    case STATE_CHECK_BUTTON:
      if (digitalRead(PIN_BUTTON) == 0) {
        // 0 = pressed
        setState(STATE_SAY_TIME);
      }
      break;

    case STATE_BLINK:
      {
        if (flagNtpInited && timeClient.isTimeSet()) {
          if (timeClient.getSeconds() == previousSecond) {
            flagNewSecond = false;
          } else {
            previousSecond = timeClient.getSeconds();
            flagNewSecond = true;

            if (timeClient.getSeconds()%5 == 0) {
              if (flagWifiConnected && flagMqttConnected && flagSpeechInited && flagConfigured && flagNtpInited) {
                // everything good
                ledRGB(LED_COLOR_GREEN_3);
              } else {
                // need initialize
                ledRGB(LED_COLOR_RED_3);
              }
            }
          }
        } else {
          ledRGB(LED_COLOR_BLUE);  // NTP or time not synced
        }
        delay(50);
        ledRGB(LED_COLOR_OFF);
      }
      break;

    case STATE_CHECK_SAY_TIME:
      {
        if (flagNewSecond && timeClient.getSeconds() == 0) {
          for (uint16_t i = 0; i < sizeof(eeprom.sayTime) / (sizeof(uint8_t) * 2); i++) {
            if (timeClient.getHours() == eeprom.sayTime[i][0] && timeClient.getMinutes() == eeprom.sayTime[i][1]) {
              Serial.println("TIME: Time match say time");
              setState(STATE_SAY_TIME);
            }
          }
        }
      }
      break;

    case STATE_CHECK_SAY_BEEP:
      {
        if (flagNewSecond && timeClient.getSeconds() == 0) {
          for (uint16_t i = 0; i < sizeof(eeprom.sayBeep) / (sizeof(uint8_t) * 2); i++) {
            if (timeClient.getHours() == eeprom.sayBeep[i][0] && timeClient.getMinutes() == eeprom.sayBeep[i][1]) {
              Serial.println("TIME: Time match say beep");
              setState(STATE_SAY_BEEP);
            }
          }
        }
      }
      break;

    // ---------------------------------
    // Special states from 1000
    // ---------------------------------

    case STATE_MQTT_STATUS:  // mqtt command "status"
      {
        ledRGB(LED_COLOR_WHITE);
        String topic;
        topic = getTopic("status/ip");
        mqttClient.publish(topic.c_str(), WiFi.localIP().toString().c_str());
        delay(5);
        topic = getTopic("status/ssid");
        mqttClient.publish(topic.c_str(), wifiManager.getWiFiSSID().c_str());
        delay(5);
        topic = getTopic("status/time_set");

        if (timeClient.isTimeSet()) {
          mqttClient.publish(topic.c_str(), "1");
        } else {
          mqttClient.publish(topic.c_str(), "0");
        }
        delay(5);
        topic = getTopic("status/time");
        mqttClient.publish(topic.c_str(), timeClient.getFormattedTime().c_str());
        delay(5);
        topic = getTopic("status/timeOffset");
        mqttClient.publish(topic.c_str(), String(eeprom.ntp_timeoffset).c_str());

        for (uint16_t i = 0; i < sizeof(eeprom.sayTime) / (sizeof(uint8_t) * 2); i++) {
          topic = getTopic("status/sayTime_" + String(i));
          String hour = String(eeprom.sayTime[i][0]);
          String minute = String(eeprom.sayTime[i][1]);
          if (eeprom.sayTime[i][0] == 0xff || eeprom.sayTime[i][1] == 0xff) {
            hour = "-";
            minute = "-";
          }
          String timeStr = hour + ":" + minute;
          mqttClient.publish(topic.c_str(), timeStr.c_str());
          delay(5);
        }

        for (uint16_t i = 0; i < sizeof(eeprom.sayBeep) / (sizeof(uint8_t) * 2); i++) {
          topic = getTopic("status/sayBeep_" + String(i));
          String hour = String(eeprom.sayBeep[i][0]);
          String minute = String(eeprom.sayBeep[i][1]);
          if (eeprom.sayBeep[i][0] == 0xff || eeprom.sayBeep[i][1] == 0xff) {
            hour = "-";
            minute = "-";
          }
          String timeStr = hour + ":" + minute;
          mqttClient.publish(topic.c_str(), timeStr.c_str());
          delay(5);
        }

        ledRGB(LED_COLOR_OFF);
      }
      break;
    
    case STATE_EEPROM_SAVE:  // save eeprom
      Serial.println("EEPROM: Saving");
      ledRGB(LED_COLOR_WHITE);
      EEPROM.put(0, eeprom);
      delay(250);
      EEPROM.commit();

      // reload ntp timeOffset
      timeClient.setTimeOffset(eeprom.ntp_timeoffset);

      ledRGB(LED_COLOR_OFF);
      delay(250);
      break;

    case STATE_SAY_TIME:
      {
        ledRGB(LED_COLOR_PINK);
        pinMode(PIN_PWM, OUTPUT);
        digitalWrite(PIN_PTT, LOW);
        delay(1000);

        voice.say(spTHE);
        voice.say(spTIME);
        voice.say(spIS);
        sayDigit(timeClient.getHours());

        if (timeClient.getMinutes() != 0) {
          sayDigit(timeClient.getMinutes());
        }

        digitalWrite(PIN_PTT, HIGH);
        pinMode(PIN_PWM, INPUT);
        ledRGB(LED_COLOR_OFF);
      }
      break;

  
    case STATE_SAY_BEEP:
      {
        ledRGB(LED_COLOR_PINK);
        pinMode(PIN_PWM, OUTPUT);
        digitalWrite(PIN_PTT, LOW);
        delay(1000);

        voice.say(spTONE1);

        digitalWrite(PIN_PTT, HIGH);
        pinMode(PIN_PWM, INPUT);
        ledRGB(LED_COLOR_OFF);
      }
      break;

    default:  // always default to state 100
      setState(100);
      break;
  }

  // End loop
  delay(5);
 
  // Iterate state or set new state
  State = State + 1;
  if (newState != 0) {
    State = newState;
    newState = 0;
  }
}

void setState(int s) {
  newState = s;  // next loop, new state will be set
}

void sayDigit(int digit) {
    Serial.print("Say: ");
    Serial.print(digit);
    Serial.print("\n");

    switch (digit) {
    case 0:
      voice.say(spTWENTY);
      voice.say(spFOUR);
      break;
    case 1:
      voice.say(spONE);
      break;
    case 2:
      voice.say(spTWO);
      break;
    case 3:
      voice.say(spTHREE);
      break;
    case 4:
      voice.say(spFOUR);
      break;
    case 5:
      voice.say(spFIVE);
      break;
    case 6:
      voice.say(spSIX);
      break;
    case 7:
      voice.say(spSEVEN);
      break;
    case 8:
      voice.say(spEIGHT);
      break;
    case 9:
      voice.say(spNINE);
      break;
    case 10:
      voice.say(spTEN);
      break;
    case 11:
      voice.say(spELEVEN);
      break;
    case 12:
      voice.say(spTWELVE);
      break;
    case 13:
      voice.say(spTHIRTEEN);
      break;
    case 14:
      voice.say(spFOURTEEN);
      break;
    case 15:
      voice.say(spFIFTEEN);
      break;
    case 16:
      voice.say(spSIXTEEN);
      break;
    case 17:
      voice.say(spSEVENTEEN);
      break;
    case 18:
      voice.say(spEIGHTEEN);
      break;
    case 19:
      voice.say(spNINETEEN);
      break;
  }
  if (digit >= 20 and digit < 30) {
    voice.say(spTWENTY);
  }
  if (digit >= 30 and digit < 40) {
    voice.say(spTHIRTY);
  }
  if (digit >= 40 and digit < 50) {
    voice.say(spFOURTY);
  }
  if (digit >= 50 and digit < 60) {
    voice.say(spFIFTY);
  }
  if (digit >= 20) {
    int halv_digit = digit % 10;
    if (halv_digit > 0) {
      sayDigit(halv_digit);
    }
  }
}

void ledRGB(uint8_t r, uint8_t g, uint8_t b) {
  rgb_driver.setLedColorData(0, r, g, b);
	rgb_driver.show();   // Send color data to LED
}

void ledBlue(bool state) {
  if (state) {
    digitalWrite(LED_BLUE, HIGH);
  } else {
    digitalWrite(LED_BLUE, LOW);
  }
}

String getTopic(String t) {
  String topic = "say_time/";
  topic += String(WiFi.macAddress());
  topic.replace(":", "");
  topic = topic + "/" + t;
  return topic;
}

void mqttCallback(char* t, byte* payload, unsigned int length) {
  String buff = "";
  String topic = t;

  for (size_t i = 0; i < length; i++) {
    buff.concat((char)payload[i]);
  }

  Serial.println("MQTT: Topic: " + topic);
  Serial.println("MQTT: Received: " + buff);

  if (String(topic).endsWith("command")) {
    if (buff.equals("status")) {
      setState(STATE_MQTT_STATUS);
    }
    if (buff.equals("restart")) {
      setState(STATE_ERROR);
    }
    if (buff.equals("say")) {
      setState(STATE_SAY_TIME);
    }
  }

  if (topic.endsWith("setTimeOffset")) {
    eeprom.ntp_timeoffset = buff.toInt();
    setState(STATE_EEPROM_SAVE);
  }

  String subTopic = topic.substring(topic.lastIndexOf("/") + 1);

  if (subTopic.startsWith("setSayTime_")) {
    uint16_t new_time_hours = String(buff.substring(0, 2)).toInt();
    uint16_t new_time_minutes = String(buff.substring(3, 5)).toInt();
    uint8_t i = subTopic.substring(subTopic.indexOf("_") + 1).toInt();
    eeprom.sayTime[i][0] = new_time_hours;
    eeprom.sayTime[i][1] = new_time_minutes;    
    setState(STATE_EEPROM_SAVE);
  }

  if (subTopic.startsWith("setSayBeep_")) {
    uint16_t new_time_hours = String(buff.substring(0, 2)).toInt();
    uint16_t new_time_minutes = String(buff.substring(3, 5)).toInt();
    uint8_t i = subTopic.substring(subTopic.indexOf("_") + 1).toInt();
    eeprom.sayBeep[i][0] = new_time_hours;
    eeprom.sayBeep[i][1] = new_time_minutes;    
    setState(STATE_EEPROM_SAVE);
  }
}

void saveConfigCallback () {
  Serial.println("CONFIG: Save config");

  Serial.println("CONFIG: ssid " + wifiManager.getWiFiSSID());
  strncpy(eeprom.wifi_ssid, wifiManager.getWiFiSSID().c_str(), 32);

  Serial.println("CONFIG: pwd " + wifiManager.getWiFiPass());
  strncpy(eeprom.wifi_password, wifiManager.getWiFiPass().c_str(), 32);

  Serial.println("CONFIG: MQTT server " + String(custom_mqtt_server.getValue()));
  strncpy(eeprom.mqtt_server, custom_mqtt_server.getValue(), 30);

  Serial.println("CONFIG: MQTT username " + String(custom_mqtt_username.getValue()));
  strncpy(eeprom.mqtt_username, custom_mqtt_username.getValue(), 30);

  Serial.println("CONFIG: MQTT password " + String(custom_mqtt_password.getValue()));
  strncpy(eeprom.mqtt_password, custom_mqtt_password.getValue(), 30);

  Serial.println("CONFIG: MQTT port " + String(custom_mqtt_server_port.getValue()));
  eeprom.mqtt_server_port = String(custom_mqtt_server_port.getValue()).toInt();

  Serial.println("CONFIG: NTP server " + String(custom_ntp_server.getValue()));
  strncpy(eeprom.ntp_server, custom_ntp_server.getValue(), 30);

  Serial.println("CONFIG: NTP timeoffset " + String(custom_ntp_timeoffset.getValue()));
  eeprom.ntp_timeoffset = String(custom_ntp_timeoffset.getValue()).toInt();

  flagNtpInited = false;  // reinit

  setState(STATE_EEPROM_SAVE);
}
